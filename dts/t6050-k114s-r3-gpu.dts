// SPDX-License-Identifier: GPL-2.0+ OR MIT
/*
 * K114s candidate r3, GPU step: r1 plus the GPU only. The panel stays the boot framebuffer.
 * Booted on a K114s through aura-try since 2026-11-14: see docs/r3-gpu-result.md.
 */
#define K114S_R1_N1
#define K114S_R1_USB
#include "t6050-k114s-common.dtsi"
#define K114S_R3_GPU
#include "t6050-k114s-display-gpu.dtsi"
