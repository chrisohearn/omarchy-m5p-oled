// SPDX-License-Identifier: GPL-2.0+ OR MIT
/*
 * K114s candidate r3, first step: r1 plus the eDP mark on the boot framebuffer. Nothing else
 * changes. Not booted on a K114s. See docs/r3-display-gpu.md.
 */
#define K114S_R1_N1
#define K114S_R1_USB
#include "t6050-k114s-common.dtsi"
#define K114S_R3_EDP
#include "t6050-k114s-display-gpu.dtsi"
